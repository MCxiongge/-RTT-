## lora_slave/lora4/rt_thread-lm401_PingPong_V1.0_202209/board/Kconfig
```kconfig
menu "Hardware Drivers Config"

config SOC_STM32WLE5CB
    bool
    select SOC_SERIES_STM32WL
	select STM32WLE5xx
    select RT_USING_COMPONENTS_INIT
    select RT_USING_USER_MAIN
    default y

menu "Onboard Peripheral Drivers"

    config BSP_USING_USB_TO_UART
        bool "Enable USB TO UART (lpuart1)"
        select BSP_USING_UART
        select BSP_USING_LPUART1
        default y

endmenu

menu "On-chip Peripheral Drivers"

    config BSP_USING_GPIO
        bool "Enable GPIO"
        select RT_USING_PIN
        default y
    
    menuconfig BSP_USING_ONCHIP_RTC
        bool "Enable RTC"
        default n
        if BSP_USING_ONCHIP_RTC
            choice
                prompt "Select clock source"
                default BSP_RTC_USING_LSE

                config BSP_RTC_USING_LSE
                    bool "RTC USING LSE"

                config BSP_RTC_USING_LSI
                    bool "RTC USING LSI"
            endchoice
        endif
		

    menuconfig BSP_USING_UART
        bool "Enable UART"
        default y
        select RT_USING_SERIAL
        if BSP_USING_UART
            config BSP_USING_UART1
                bool "Enable UART1"
                default n   
                
            config BSP_UART1_RX_USING_DMA
                bool "Enable UART1 RX DMA"
                depends on BSP_USING_UART1 && RT_SERIAL_USING_DMA
                default n
                
            config BSP_USING_UART2
                bool "Enable UART2"
                default n   
                
            config BSP_UART2_RX_USING_DMA
                bool "Enable UART2 RX DMA"
                depends on BSP_USING_UART2 && RT_SERIAL_USING_DMA
                default n

            config BSP_USING_LPUART1
                bool "Enable LPUART1"
                default y
            config BSP_LPUART1_RX_USING_DMA
                bool "Enable LPUART1 RX DMA"
                depends on BSP_USING_LPUART1 && RT_SERIAL_USING_DMA
                default n
               
        endif
		
		menuconfig BSP_USING_SUBGHZ
        bool "Enable SUBGHZ"
        default n
		if BSP_USING_SUBGHZ
            choice
                prompt "Select timer source"
                default LORA_RADIO_DRIVER_USING_RTOS_RT_THREAD

                config LORA_RADIO_DRIVER_USING_RTOS_RT_THREAD
                    bool "USING RT_THREAD RTIMER"

                config PKG_USING_MULTI_RTIMER
                    bool "USING MULTI RTIMER"
            endchoice
        endif
        
endmenu

menu "Board extended module Drivers"

endmenu

endmenu
```
